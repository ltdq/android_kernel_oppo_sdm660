/* Copyright (c) 2016-2017, The Linux Foundation. All rights reserved.
 *
 * This program is free software; you can redistribute it and/or modify
 * it under the terms of the GNU General Public License version 2 and
 * only version 2 as published by the Free Software Foundation.
 *
 * This program is distributed in the hope that it will be useful,
 * but WITHOUT ANY WARRANTY; without even the implied warranty of
 * MERCHANTABILITY or FITNESS FOR A PARTICULAR PURPOSE.  See the
 * GNU General Public License for more details.
 */

/* Disable WLED */
&pm660l_wled {
	status = "disabled";
};

/* disable LCDB */
&pm660l_lcdb {
	status = "disabled";
};

&pm660a_oledb {
#if defined(CONFIG_OPPO_16051)
	status = "okay";
#elif defined(CONFIG_OPPO_16103) || defined(CONFIG_OPPO_16118)
    status = "disabled";
#endif
};

&pm660a_labibb {
#if defined(CONFIG_OPPO_16051)
	status = "okay";
#elif defined(CONFIG_OPPO_16103) || defined(CONFIG_OPPO_16118)
    status = "disabled";
#endif
};
